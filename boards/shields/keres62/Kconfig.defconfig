## boards/shields/keres62/Kconfig.defconfig
```kconfig
if SHIELD_KERES62_LEFT

# Name must be less than 16 characters long!
config ZMK_KEYBOARD_NAME
    default "Keres62"

config ZMK_SPLIT_ROLE_CENTRAL
    default y

endif

if SHIELD_KERES62_LEFT || SHIELD_KERES62_RIGHT

config ZMK_SPLIT
    default y

endif
```

## boards/shields/keres62/Kconfig.shield
```kconfig
config SHIELD_KERES62_LEFT
    def_bool $(shields_list_contains,keres62_left)


config SHIELD_KERES62_RIGHT
    def_bool $(shields_list_contains,keres62_right)
```
